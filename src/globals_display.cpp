#include "globals_display.h"
#include "globals.h"

int const anzahlfarben=14;
// palette in PROGMEM
const uint8_t farben[][3] PROGMEM = {
    {255,255,255},{255,0,0},{255,0,128},{255,0,255},{128,0,255},{0,0,255},{0,128,255},{0,255,255},{0,255,128},{0,255,0},{128,255,0},{255,255,0},{255,128,0},{0,0,0}
};

void getPaletteColor(uint8_t idx, int out[3]){
    if(idx >= (uint8_t)anzahlfarben){
        out[0]=0; out[1]=0; out[2]=0; return;
    }
    out[0] = (int)pgm_read_byte(&farben[idx][0]);
    out[1] = (int)pgm_read_byte(&farben[idx][1]);
    out[2] = (int)pgm_read_byte(&farben[idx][2]);
}

const int matrixminmodulomap[4]={2, 4, 6, 8};

int ste=62;

// ES IST/IS length - set by build version
#if VERSION_TYPE == 1
  int iist = 5;  // Bayrisch: ES IS
#else
  int iist = 6;  // Deutsch: ES IST
#endif

// Next hour threshold - set by build version
#if VERSION_TYPE == 1
  int nexthour = 4;  // Bayrisch: ab 20 min (10 vor halb)
#elif VERSION_TYPE == 2
  int nexthour = 4;  // Mini 8x8: ab 20 min
#else
  int nexthour = 5;  // Deutsch: ab 25 min (halb)
#endif

int vordergrundschema=0;
#if MATRIX_SIZE == 11
int vordergrund[11][11][3]={
  {{0,0,0},{0,0,0},{0,0,0},{0,0,0},{0,0,0},{0,0,0},{0,0,0},{0,0,0},{0,0,0},{0,0,0},{0,0,0}},
  {{0,0,0},{0,0,0},{0,0,0},{0,0,0},{0,0,0},{0,0,0},{0,0,0},{0,0,0},{0,0,0},{0,0,0},{0,0,0}},
  {{0,0,0},{0,0,0},{0,0,0},{0,0,0},{0,0,0},{0,0,0},{0,0,0},{0,0,0},{0,0,0},{0,0,0},{0,0,0}},
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  {{0,0,0},{0,0,0},{0,0,0},{0,0,0},{0,0,0},{0,0,0},{0,0,0},{0,0,0},{0,0,0},{0,0,0},{0,0,0}}
};
#elif MATRIX_SIZE == 8
int vordergrund[8][8][3]={
  {{0,0,0},{0,0,0},{0,0,0},{0,0,0},{0,0,0},{0,0,0},{0,0,0},{0,0,0}},
  {{0,0,0},{0,0,0},{0,0,0},{0,0,0},{0,0,0},{0,0,0},{0,0,0},{0,0,0}},
  {{0,0,0},{0,0,0},{0,0,0},{0,0,0},{0,0,0},{0,0,0},{0,0,0},{0,0,0}},
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  {{0,0,0},{0,0,0},{0,0,0},{0,0,0},{0,0,0},{0,0,0},{0,0,0},{0,0,0}}
};
#endif

int hintergrundschema=0;
#if MATRIX_SIZE == 11
int hintergrund[11][11][3]={
  {{0,0,0},{0,0,0},{0,0,0},{0,0,0},{0,0,0},{0,0,0},{0,0,0},{0,0,0},{0,0,0},{0,0,0},{0,0,0}},
  {{0,0,0},{0,0,0},{0,0,0},{0,0,0},{0,0,0},{0,0,0},{0,0,0},{0,0,0},{0,0,0},{0,0,0},{0,0,0}},
  {{0,0,0},{0,0,0},{0,0,0},{0,0,0},{0,0,0},{0,0,0},{0,0,0},{0,0,0},{0,0,0},{0,0,0},{0,0,0}},
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  {{0,0,0},{0,0,0},{0,0,0},{0,0,0},{0,0,0},{0,0,0},{0,0,0},{0,0,0},{0,0,0},{0,0,0},{0,0,0}}
};
#elif MATRIX_SIZE == 8
int hintergrund[8][8][3]={
  {{0,0,0},{0,0,0},{0,0,0},{0,0,0},{0,0,0},{0,0,0},{0,0,0},{0,0,0}},
  {{0,0,0},{0,0,0},{0,0,0},{0,0,0},{0,0,0},{0,0,0},{0,0,0},{0,0,0}},
  {{0,0,0},{0,0,0},{0,0,0},{0,0,0},{0,0,0},{0,0,0},{0,0,0},{0,0,0}},
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  {{0,0,0},{0,0,0},{0,0,0},{0,0,0},{0,0,0},{0,0,0},{0,0,0},{0,0,0}}
};
#endif

#if MATRIX_SIZE == 11
int anzeige[11][11][3]={
  {{0,0,0},{0,0,0},{0,0,0},{0,0,0},{0,0,0},{0,0,0},{0,0,0},{0,0,0},{0,0,0},{0,0,0},{0,0,0}},
  {{0,0,0},{0,0,0},{0,0,0},{0,0,0},{0,0,0},{0,0,0},{0,0,0},{0,0,0},{0,0,0},{0,0,0},{0,0,0}},
  {{0,0,0},{0,0,0},{0,0,0},{0,0,0},{0,0,0},{0,0,0},{0,0,0},{0,0,0},{0,0,0},{0,0,0},{0,0,0}},
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  {{0,0,0},{0,0,0},{0,0,0},{0,0,0},{0,0,0},{0,0,0},{0,0,0},{0,0,0},{0,0,0},{0,0,0},{0,0,0}}
};
#elif MATRIX_SIZE == 8
int anzeige[8][8][3]={
  {{0,0,0},{0,0,0},{0,0,0},{0,0,0},{0,0,0},{0,0,0},{0,0,0},{0,0,0}},
  {{0,0,0},{0,0,0},{0,0,0},{0,0,0},{0,0,0},{0,0,0},{0,0,0},{0,0,0}},
  {{0,0,0},{0,0,0},{0,0,0},{0,0,0},{0,0,0},{0,0,0},{0,0,0},{0,0,0}},
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  {{0,0,0},{0,0,0},{0,0,0},{0,0,0},{0,0,0},{0,0,0},{0,0,0},{0,0,0}}
};
#endif
#if MATRIX_SIZE == 11
int anzeigealt[11][11][3]={
   {{0,0,0},{0,0,0},{0,0,0},{0,0,0},{0,0,0},{0,0,0},{0,0,0},{0,0,0},{0,0,0},{0,0,0},{0,0,0}},
  {{0,0,0},{0,0,0},{0,0,0},{0,0,0},{0,0,0},{0,0,0},{0,0,0},{0,0,0},{0,0,0},{0,0,0},{0,0,0}},
  {{0,0,0},{0,0,0},{0,0,0},{0,0,0},{0,0,0},{0,0,0},{0,0,0},{0,0,0},{0,0,0},{0,0,0},{0,0,0}},
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  {{0,0,0},{0,0,0},{0,0,0},{0,0,0},{0,0,0},{0,0,0},{0,0,0},{0,0,0},{0,0,0},{0,0,0},{0,0,0}}
};
#elif MATRIX_SIZE == 8
int anzeigealt[8][8][3]={
  {{0,0,0},{0,0,0},{0,0,0},{0,0,0},{0,0,0},{0,0,0},{0,0,0},{0,0,0}},
  {{0,0,0},{0,0,0},{0,0,0},{0,0,0},{0,0,0},{0,0,0},{0,0,0},{0,0,0}},
  {{0,0,0},{0,0,0},{0,0,0},{0,0,0},{0,0,0},{0,0,0},{0,0,0},{0,0,0}},
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  {{0,0,0},{0,0,0},{0,0,0},{0,0,0},{0,0,0},{0,0,0},{0,0,0},{0,0,0}}
};
#endif

#if MATRIX_SIZE == 11
int matrix[11][11]={
  {110,111,112,113,114,115,116,117,118,119,120},
  {109,108,107,106,105,104,103,102,101,100,99},
  {88, 89, 90, 91, 92, 93, 94, 95, 96, 97, 98},
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  {0,1,2,3,4,5,6,7,8,9,10}
};
#elif MATRIX_SIZE == 8
int matrix[8][8]={
  {0,1,2,3,4,5,6,7},
  {8,9,10,11,12,13,14,15},
  {16,17,18,19,20,21,22,23},
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  {56,57,58,59,60,61,62,63}
};
#endif

#if MATRIX_SIZE == 11
int matrixanzeige[11][11]={
  {0,0,0,0,0,0,0,0,0,0,0},
  {0,0,0,0,0,0,0,0,0,0,0},
  {0,0,0,0,0,0,0,0,0,0,0},
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  {0,0,0,0,0,0,0,0,0,0,0}
};
#elif MATRIX_SIZE == 8
int matrixanzeige[8][8]={
  {0,0,0,0,0,0,0,0},
  {0,0,0,0,0,0,0,0},
  {0,0,0,0,0,0,0,0},
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  {0,0,0,0,0,0,0,0}
};
#endif

// Eigenes Farb-Grid fuer den Pomodoro-Modus - keine expliziten Literale
// noetig, globale Arrays werden in C++ automatisch nullinitialisiert.
uint8_t pomodoroGrid[MATRIX_SIZE][MATRIX_SIZE][3];

// inverse mapping (filled by buildLedMappings)
int16_t ledRow[LED_COUNT];
int16_t ledCol[LED_COUNT];

// LED lists for minute/hour words (runtime)
int16_t matrixmin_leds[12][MAX_WORD_LEDS];
uint8_t matrixmin_count[12];
int16_t matrixstunden_leds[12][MAX_WORD_LEDS];
uint8_t matrixstunden_count[12];

// Build LED-index mappings from the range-based maps (matrixminmap/matrixstundenmap)
#include "ledmap.h"

// initialize inverse map and copy static lists from flash into runtime arrays
void buildLedMappings() {
    // init inverse maps to -1
    for (int i = 0; i < LED_COUNT; ++i) {
        ledRow[i] = -1;
        ledCol[i] = -1;
    }
    // build inverse map from matrix[row][col] -> (row,col)
    for (int r = 0; r < MATRIX_SIZE; ++r) {
        for (int c = 0; c < MATRIX_SIZE; ++c) {
            int idx = matrix[r][c];
            if (idx >= 0 && idx < LED_COUNT) {
                ledRow[idx] = r;
                ledCol[idx] = c;
            }
        }
    }

    // static lists live in ledmap.h (PROGMEM)

    // copy selected static lists from PROGMEM into runtime arrays
    for (int i = 0; i < 12; ++i) {
        matrixmin_count[i] = 0;
        for (int k = 0; k < MAX_WORD_LEDS; ++k) {
            uint8_t raw;
            #if VERSION_TYPE == 0
                // Deutsche Version - aber Runtime-Umschaltung auf Bayrisch möglich
                if (dbv == 1) {
                    raw = (uint8_t)pgm_read_byte(&bay_min_lists[i][k]);
                } else {
                    raw = (uint8_t)pgm_read_byte(&std_min_lists[i][k]);
                }
            #elif VERSION_TYPE == 1
                // Bayrische Version
                raw = (uint8_t)pgm_read_byte(&bay_min_lists[i][k]);
            #elif VERSION_TYPE == 2
                // Mini Version
                raw = (uint8_t)pgm_read_byte(&mini_min_lists[i][k]);
            #else
                // Fallback: Deutsche Version
                if (dbv == 1) {
                    raw = (uint8_t)pgm_read_byte(&bay_min_lists[i][k]);
                } else {
                    raw = (uint8_t)pgm_read_byte(&std_min_lists[i][k]);
                }
            #endif
            
            // dvv override (nur für deutsche/bayrische Version)
            #if VERSION_TYPE != 2
            if (i == 9 && dvv == 1 && k < MAX_WORD_LEDS) {
                raw = (uint8_t)pgm_read_byte(&dvv9_list[k]);
            }
            #endif
            
            int16_t v = (raw == 255) ? -1 : (int16_t)raw;
            matrixmin_leds[i][k] = v;
            if (v >= 0) matrixmin_count[i]++;
        }
    }

    for (int i = 0; i < 12; ++i) {
        matrixstunden_count[i] = 0;
        for (int k = 0; k < MAX_WORD_LEDS; ++k) {
            uint8_t raw;
            #if VERSION_TYPE == 0
                // Deutsche Version - aber Runtime-Umschaltung auf Bayrisch möglich
                if (dbv == 1) {
                    raw = (uint8_t)pgm_read_byte(&bay_hour_lists[i][k]);
                } else {
                    raw = (uint8_t)pgm_read_byte(&std_hour_lists[i][k]);
                }
            #elif VERSION_TYPE == 1
                // Bayrische Version
                raw = (uint8_t)pgm_read_byte(&bay_hour_lists[i][k]);
            #elif VERSION_TYPE == 2
                // Mini Version
                raw = (uint8_t)pgm_read_byte(&mini_hour_lists[i][k]);
            #else
                // Fallback: Deutsche Version
                if (dbv == 1) {
                    raw = (uint8_t)pgm_read_byte(&bay_hour_lists[i][k]);
                } else {
                    raw = (uint8_t)pgm_read_byte(&std_hour_lists[i][k]);
                }
            #endif
            
            int16_t v = (raw == 255) ? -1 : (int16_t)raw;
            matrixstunden_leds[i][k] = v;
            if (v >= 0) matrixstunden_count[i]++;
        }
    }
    // validate lists
    validateLedLists();
}

bool validateLedLists() {
    bool ok = true;
    for (int w = 0; w < 12; ++w) {
        for (int k = 0; k < matrixmin_count[w]; ++k) {
            int16_t v = matrixmin_leds[w][k];
            if (v < 0 || v >= LED_COUNT) {
                LOG("Invalid minute led index: "); LOGLN(v);
                ok = false;
            }
        }
    }
    for (int w = 0; w < 12; ++w) {
        for (int k = 0; k < matrixstunden_count[w]; ++k) {
            int16_t v = matrixstunden_leds[w][k];
            if (v < 0 || v >= LED_COUNT) {
                LOG("Invalid hour led index: "); LOGLN(v);
                ok = false;
            }
        }
    }
    return ok;
}

uint8_t getWordLedCount(uint8_t minuteOrHourIndex, bool isHour) {
    return isHour ? matrixstunden_count[minuteOrHourIndex] : matrixmin_count[minuteOrHourIndex];
}

int16_t getWordLed(uint8_t minuteOrHourIndex, bool isHour, uint8_t idx) {
    return isHour ? matrixstunden_leds[minuteOrHourIndex][idx] : matrixmin_leds[minuteOrHourIndex][idx];
}


//Für Einschalt animation (nur für 11x11 Matrix)
#if MATRIX_SIZE == 11
int t1[11]={27,38,49,60,71,82,91,92,93,94,95};
int t2[28]={15,16,17,26,39,48,61,70,83,84,85,90,107,106,105,104,103,102,101,96,79,80,81,72,59,50,37,28};
int t3[36]={3,4,5,6,7,14,29,36,51,58,73,74,75,78,97,100,119,118,117,116,115,114,113,112,111,108,89,86,67,68,69,62,47,40,25,18};
int t4[26]={2,19,24,41,46,63,64,65,66,87,88,109,110,8,13,30,35,52,57,56,55,76,77,98,99,120};
int t5[12]={1,20,23,42,45,44,9,12,31,34,53,54};

int startcolors[13][3]={{0,0,0},{0,0,0},{0,0,0},{0,0,0},{0,0,255},{0,64,127},{0,127,127},{0,127,64},{64,64,64},{0,0,0},{0,0,0},{0,0,0},{0,0,0}};
#endif
